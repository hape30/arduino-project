// Подключаем библиотеку для работы с LCD экраном
#include <LiquidCrystal.h>

// Порты, к которым подключены компоненты
const int buttonPin = 7; // Порт для подключения кнопки
const int ledPin = 8;    // Порт для подключения светодиода
const int speakerPin = 9; // Порт для подключения динамика

// Объявляем объект lcd для работы с LCD экраном, указывая порты, к которым подключен экран
LiquidCrystal lcd(5, 4, 3, 2, 12, 11, 10, 9, 8, 7);
// Порты D0-D7 подключаются к пинам 5, 4, 3, 2, 10, 9, 8, 7 соответственно.
// RS подключается к пину 12.
// E подключается к пину 11.

long randNumber;

void setup() {
  // Начинаем передачу данных на последовательный порт для монитора последовательного порта
  Serial.begin(9600);

  // Если порт 0 неподключен, то генератор псевдослучайных чисел
  // будет инициализироваться функцией randomSeed() со случайного
  // значения при каждом запуске программы из-за "шума" на порту
  randomSeed(analogRead(0));

  // Инициализируем LCD экран с указанием его размера (количество столбцов и строк)
  lcd.begin(16, 2);

  // Устанавливаем режимы работы портов
  pinMode(buttonPin, INPUT);
  pinMode(ledPin, OUTPUT);
  pinMode(speakerPin, OUTPUT);
}

void loop() {
  // Считываем состояние кнопки
  int buttonState = digitalRead(buttonPin);

  // Если кнопка нажата
  if (buttonState == HIGH) {
    // Генерируем случайное число из диапазона 1..3
    randNumber = random(1, 4);
    
    // Отправляем сгенерированное число на монитор последовательного порта
    Serial.println(randNumber);

    // Отображаем сгенерированное число на LCD экране в первой строке, втором столбце
    lcd.setCursor(0, 0);
    lcd.print(randNumber);
    
    // Если выпало одно и то же число три раза
    if (checkThreeEqual(randNumber)) {
      // Включаем светодиод
      digitalWrite(ledPin, HIGH);
      
      // Воспроизводим звук на динамике
      tone(speakerPin, 1000, 500);
    } else {
      // Выключаем светодиод
      digitalWrite(ledPin, LOW);
    }
  }
}

// Функция для проверки того, выпало ли одно и то же число три раза подряд
boolean checkThreeEqual(long number) {
  static long prevNumber = 0; // Предыдущее число
  static int count = 0;       // Счётчик для подсчёта количества повторений

  if (number == prevNumber) {
    count++; // Увеличиваем счётчик, если число совпадает с предыдущим
  } else {
    count = 1; // Сбрасываем счётчик, если число не совпадает с предыдущим
  }

  prevNumber = number; // Запоминаем текущее число как предыдущее

  // Если число совпало три раза подряд, возвращаем true, иначе false
  return (count == 3);
}
